#include "I2Cdev.h"
#include "MPU6050.h"
#include <BLEDevice.h>
#include <BLEServer.h>
#include <BLEUtils.h>
#include <BLE2902.h>

#include "feature_extractor.h"  // push_sample(), extract_features()
#include "model.h"              // gesture_model_predict()   ← generated by train.py
#include "scaler_params.h"      // normalize_features(), CLASS_NAMES  ← generated by train.py

// ── BLE UART UUIDs (Nordic UART Service standard) ──────────
#define SERVICE_UUID           "6E400001-B5A3-F393-E0A9-E50E24DCCA9E"
#define CHARACTERISTIC_UUID_TX "6E400003-B5A3-F393-E0A9-E50E24DCCA9E"

BLECharacteristic *pTxCharacteristic;
bool deviceConnected = false;

// ── BLE connection callbacks ────────────────────────────────
class MyServerCallbacks : public BLEServerCallbacks {
  void onConnect(BLEServer *pServer)    { deviceConnected = true;  }
  void onDisconnect(BLEServer *pServer) {
    deviceConnected = false;
    pServer->startAdvertising();
  }
};

// ── Sensors ────────────────────────────────────────────────
MPU6050 mpu1(0x68);
MPU6050 mpu2(0x69);

int16_t ax1, ay1, az1, gx1, gy1, gz1;
int16_t ax2, ay2, az2, gx2, gy2, gz2;

// ── Buzzer ─────────────────────────────────────────────────
#define BUZZER_PIN 20

void beep(int freq, int duration) {
  tone(BUZZER_PIN, freq, duration);
  delay(duration + 30);
}

void startChime() {
  beep(800, 80);
  beep(800, 80);
  noTone(BUZZER_PIN);
}

void calibrationChime() {
  beep(523,  120); // C5
  beep(659,  120); // E5
  beep(784,  120); // G5
  beep(1047, 300); // C6
  noTone(BUZZER_PIN);
}

void gestureChime() {
  beep(1200, 60);
  noTone(BUZZER_PIN);
}

// ── Timing ─────────────────────────────────────────────────
uint32_t lastMillis = 0;
const int POLLING_MS = 100; // 10 Hz — matches recording rate

// ── Setup ──────────────────────────────────────────────────
void setup() {
  Wire.begin();
  Serial.begin(115200);
  pinMode(LED_BUILTIN, OUTPUT);
  pinMode(BUZZER_PIN, OUTPUT);

  // ── BLE init ────────────────────────────────────────────
  BLEDevice::init("ESP32_IMU");
  BLEServer *pServer = BLEDevice::createServer();
  pServer->setCallbacks(new MyServerCallbacks());

  BLEService *pService = pServer->createService(SERVICE_UUID);
  pTxCharacteristic = pService->createCharacteristic(
    CHARACTERISTIC_UUID_TX,
    BLECharacteristic::PROPERTY_NOTIFY
  );
  pTxCharacteristic->addDescriptor(new BLE2902());
  pService->start();

  BLEAdvertising *pAdvertising = BLEDevice::getAdvertising();
  pAdvertising->addServiceUUID(SERVICE_UUID);
  pAdvertising->start();
  Serial.println("BLE advertising as 'ESP32_IMU'");

  // ── Init MPU1 (0x68) ────────────────────────────────────
  Serial.println("Initializing MPU1 (0x68)...");
  mpu1.initialize();
  if (!mpu1.testConnection()) {
    Serial.println("MPU1 connection FAILED");
    while (true);
  }
  Serial.println("MPU1 OK");

  // ── Init MPU2 (0x69) ────────────────────────────────────
  Serial.println("Initializing MPU2 (0x69)...");
  mpu2.initialize();
  if (!mpu2.testConnection()) {
    Serial.println("MPU2 connection FAILED");
    while (true);
  }
  Serial.println("MPU2 OK");

  // ── Calibration ─────────────────────────────────────────
  Serial.println("Calibrating – keep sensors still...");
  startChime();
  digitalWrite(LED_BUILTIN, HIGH);
  delay(5000);
  digitalWrite(LED_BUILTIN, LOW);

  // Replace with values from MPU6050_Zero sketch
  mpu1.setXAccelOffset(0);
  mpu1.setYAccelOffset(0);
  mpu1.setZAccelOffset(0);
  mpu1.setXGyroOffset(0);
  mpu1.setYGyroOffset(0);
  mpu1.setZGyroOffset(0);

  mpu2.setXAccelOffset(0);
  mpu2.setYAccelOffset(0);
  mpu2.setZAccelOffset(0);
  mpu2.setXGyroOffset(0);
  mpu2.setYGyroOffset(0);
  mpu2.setZGyroOffset(0);

  calibrationChime();
  digitalWrite(LED_BUILTIN, HIGH);
  delay(200);
  digitalWrite(LED_BUILTIN, LOW);
  Serial.println("Ready.");
}

// ── Loop ───────────────────────────────────────────────────
void loop() {
  uint32_t currentMillis = millis();
  if (currentMillis - lastMillis < POLLING_MS) return;
  lastMillis = currentMillis;

  // Read both sensors
  mpu1.getMotion6(&ax1, &ay1, &az1, &gx1, &gy1, &gz1);
  mpu2.getMotion6(&ax2, &ay2, &az2, &gx2, &gy2, &gz2);

  // Send raw CSV over BLE (used by dataset_recorder.py)
  char buf[96];
  snprintf(buf, sizeof(buf),
    "%d,%d,%d,%d,%d,%d,%d,%d,%d,%d,%d,%d\n",
    ax1, ay1, az1, gx1, gy1, gz1,
    ax2, ay2, az2, gx2, gy2, gz2);

  Serial.print(buf);

  if (deviceConnected) {
    pTxCharacteristic->setValue((uint8_t *)buf, strlen(buf));
    pTxCharacteristic->notify();
  }

  // Push sample into inference window
  // raw int16_t values are cast to float — same scale as training data
  push_sample(
    ax1, ay1, az1, gx1, gy1, gz1,
    ax2, ay2, az2, gx2, gy2, gz2
  );

  // Run inference when window is full
  if (window_full()) {
    run_inference();
    reset_window();
  }
}

// ── Inference ──────────────────────────────────────────────
void run_inference() {
  // Compute statistical features from the window
  float features_f[FE_N_FEATURES];
  extract_features(features_f);
  normalize_features(features_f);

  // Convert to int16_t (emlearn uses fixed-point, scale = 1 for z-scored data)
  int16_t features[FE_N_FEATURES];
  for (int i = 0; i < FE_N_FEATURES; i++) {
    features[i] = (int16_t)roundf(features_f[i]);
  }

  int predicted = gesture_model_predict(features, FE_N_FEATURES);

  const char* label = (predicted >= 0 && predicted < N_CLASSES)
                      ? CLASS_NAMES[predicted]
                      : "unknown";

  Serial.printf("[Gesture] %s\n", label);

  // Beep and flash LED for any non-idle gesture
  if (predicted >= 0 && predicted < N_CLASSES
      && strcmp(label, "idle") != 0) {
    gestureChime();
    digitalWrite(LED_BUILTIN, HIGH);
    delay(100);
    digitalWrite(LED_BUILTIN, LOW);
  }
}
