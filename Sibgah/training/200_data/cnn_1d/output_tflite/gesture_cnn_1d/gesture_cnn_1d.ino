/*
 * gesture_cnn_1d.ino — Gesture detection using 1D CNN (TFLite Micro)
 *
 * Required files (copy all into this sketch folder):
 *   model_data.h     — generated by convert_to_tflite.py (run on Colab)
 *   scaler_params.h  — from cnn_1d/output_tflite/
 *   labels.h         — from cnn_1d/output_tflite/
 *
 * Library dependencies (install via Arduino Library Manager):
 *   — I2Cdevlib-MPU6050  (jrowberg)
 *   — TensorFlowLite_ESP32  (search "TensorFlowLite ESP32" by tanakamasayuki)
 *
 * Model input:  float32 [1, 25, 12]
 * Model output: float32 [1, 5]  softmax probabilities
 */

#include "I2Cdev.h"
#include "MPU6050.h"
#include <TensorFlowLite_ESP32.h>
#include "tensorflow/lite/micro/micro_interpreter.h"
#include "tensorflow/lite/micro/micro_mutable_op_resolver.h"
#include "tensorflow/lite/schema/schema_generated.h"
#include "model_data.h"
#include "scaler_params.h"
#include "labels.h"

// ── Pins / config ──────────────────────────────────────────────────────────────
#define BUZZER_PIN          20
#define SAMPLE_INTERVAL_MS  100
#define TENSOR_ARENA_SIZE   (32 * 1024)

// ── Sensors ────────────────────────────────────────────────────────────────────
MPU6050 mpu1(0x68);
MPU6050 mpu2(0x69);

// ── TFLite ────────────────────────────────────────────────────────────────────
static uint8_t            tensor_arena[TENSOR_ARENA_SIZE];
const tflite::Model*      tfl_model    = nullptr;
tflite::MicroInterpreter* interpreter  = nullptr;
TfLiteTensor*             input_tensor = nullptr;
TfLiteTensor*             output_tensor = nullptr;

// ── Window buffer ─────────────────────────────────────────────────────────────
float    window_buf[WINDOW_SIZE][N_IMU_CHANNELS];
int      sample_count = 0;
uint32_t last_ms      = 0;

// ── Buzzer helpers ─────────────────────────────────────────────────────────────
void beep(int freq, int dur) { tone(BUZZER_PIN, freq, dur); delay(dur + 30); }

void startChime()       { beep(800, 80); beep(800, 80); noTone(BUZZER_PIN); }
void calibrationChime() {
  beep(523, 120); beep(659, 120); beep(784, 120); beep(1047, 300);
  noTone(BUZZER_PIN);
}
void gestureChime()     { beep(1200, 60); noTone(BUZZER_PIN); }

// ── Inference ─────────────────────────────────────────────────────────────────
void run_inference() {
  float *in = input_tensor->data.f;
  for (int t = 0; t < WINDOW_SIZE; t++)
    for (int c = 0; c < N_IMU_CHANNELS; c++)
      in[t * N_IMU_CHANNELS + c] =
          (window_buf[t][c] - SCALER_MEAN[c]) / SCALER_STD[c];

  if (interpreter->Invoke() != kTfLiteOk) {
    Serial.println("ERROR: Invoke failed");
    return;
  }

  float *out = output_tensor->data.f;
  int best = 0;
  for (int i = 1; i < N_CLASSES; i++)
    if (out[i] > out[best]) best = i;

  Serial.printf("[1D-CNN] Gesture: %s  (%.1f%%)\n",
                GESTURE_CLASSES[best], out[best] * 100.0f);

  if (strcmp(GESTURE_CLASSES[best], "idle") != 0) {
    gestureChime();
    digitalWrite(LED_BUILTIN, HIGH); delay(100); digitalWrite(LED_BUILTIN, LOW);
  }
}

// ── Setup ─────────────────────────────────────────────────────────────────────
void setup() {
  Wire.begin();
  Serial.begin(115200);
  pinMode(LED_BUILTIN, OUTPUT);
  pinMode(BUZZER_PIN, OUTPUT);

  Serial.println("Initializing MPU1 (0x68)...");
  mpu1.initialize();
  if (!mpu1.testConnection()) { Serial.println("MPU1 FAILED"); while (1); }
  Serial.println("MPU1 OK");

  Serial.println("Initializing MPU2 (0x69)...");
  mpu2.initialize();
  if (!mpu2.testConnection()) { Serial.println("MPU2 FAILED"); while (1); }
  Serial.println("MPU2 OK");

  Serial.println("Calibrating – keep sensors still...");
  startChime();
  digitalWrite(LED_BUILTIN, HIGH);
  delay(5000);
  digitalWrite(LED_BUILTIN, LOW);

  // TODO: replace with your values from MPU6050_Zero sketch
  mpu1.setXAccelOffset(0); mpu1.setYAccelOffset(0); mpu1.setZAccelOffset(0);
  mpu1.setXGyroOffset(0);  mpu1.setYGyroOffset(0);  mpu1.setZGyroOffset(0);
  mpu2.setXAccelOffset(0); mpu2.setYAccelOffset(0); mpu2.setZAccelOffset(0);
  mpu2.setXGyroOffset(0);  mpu2.setYGyroOffset(0);  mpu2.setZGyroOffset(0);

  calibrationChime();
  digitalWrite(LED_BUILTIN, HIGH); delay(200); digitalWrite(LED_BUILTIN, LOW);

  // TFLite setup
  tfl_model = tflite::GetModel(MODEL_DATA);
  if (tfl_model->version() != TFLITE_SCHEMA_VERSION) {
    Serial.println("ERROR: Model schema mismatch"); while (1);
  }

  static tflite::MicroMutableOpResolver<4> resolver;
  resolver.AddConv2D();          // Conv1D is lowered to Conv2D
  resolver.AddMean();            // GlobalAveragePooling
  resolver.AddFullyConnected();
  resolver.AddSoftmax();

  static tflite::MicroInterpreter static_interp(
      tfl_model, resolver, tensor_arena, TENSOR_ARENA_SIZE);
  interpreter = &static_interp;

  if (interpreter->AllocateTensors() != kTfLiteOk) {
    Serial.println("ERROR: AllocateTensors failed — increase TENSOR_ARENA_SIZE");
    while (1);
  }

  input_tensor  = interpreter->input(0);
  output_tensor = interpreter->output(0);

  Serial.println("Ready [1D CNN]");
}

// ── Loop ──────────────────────────────────────────────────────────────────────
void loop() {
  uint32_t now = millis();
  if (now - last_ms < SAMPLE_INTERVAL_MS) return;
  last_ms = now;

  int16_t ax1, ay1, az1, gx1, gy1, gz1;
  int16_t ax2, ay2, az2, gx2, gy2, gz2;
  mpu1.getMotion6(&ax1, &ay1, &az1, &gx1, &gy1, &gz1);
  mpu2.getMotion6(&ax2, &ay2, &az2, &gx2, &gy2, &gz2);

  window_buf[sample_count][0]  = (float)ax1;
  window_buf[sample_count][1]  = (float)ay1;
  window_buf[sample_count][2]  = (float)az1;
  window_buf[sample_count][3]  = (float)gx1;
  window_buf[sample_count][4]  = (float)gy1;
  window_buf[sample_count][5]  = (float)gz1;
  window_buf[sample_count][6]  = (float)ax2;
  window_buf[sample_count][7]  = (float)ay2;
  window_buf[sample_count][8]  = (float)az2;
  window_buf[sample_count][9]  = (float)gx2;
  window_buf[sample_count][10] = (float)gy2;
  window_buf[sample_count][11] = (float)gz2;

  sample_count++;
  if (sample_count >= WINDOW_SIZE) {
    run_inference();
    sample_count = 0;
  }
}
